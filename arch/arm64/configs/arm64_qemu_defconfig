## arch/arm64/configs/arm64_qemu_defconfig
```kconfig
CONFIG_NUMA=y
# CONFIG_PREEMPT_DYNAMIC is not set
CONFIG_SMP=y
CONFIG_NR_CPUS=256
# CONFIG_SCHED_CLUSTER is not set
# CONFIG_SCHED_MC is not set
# CONFIG_RANDOMIZE_BASE is not set
# CONFIG_ACPI is not set
# CONFIG_VIRTUALIZATION is not set
CONFIG_MEMORY_HOTPLUG=y
CONFIG_MEMORY_HOTPLUG_DEFAULT_ONLINE=y
CONFIG_MEMORY_HOTREMOVE=y
CONFIG_NET=y
CONFIG_DEVTMPFS=y
CONFIG_DEVTMPFS_MOUNT=y
CONFIG_OF=y
CONFIG_VIRTIO_BLK=y
CONFIG_SERIAL_AMBA_PL011=y
CONFIG_SERIAL_AMBA_PL011_CONSOLE=y
CONFIG_POWER_RESET=y
CONFIG_POWER_SUPPLY=y
CONFIG_VIRTIO_INPUT=y
CONFIG_VIRTIO_MMIO=y
CONFIG_COMMON_CLK=y
CONFIG_IOMMU_DEFAULT_DMA_STRICT=y
CONFIG_EXT4_FS=y
CONFIG_DEBUG_KERNEL=y
CONFIG_DEBUG_INFO_DWARF_TOOLCHAIN_DEFAULT=y
# CONFIG_SCHED_DEBUG is not set
# CONFIG_RCU_TRACE is not set
# CONFIG_FTRACE is not set
CONFIG_CGROUPS=y
CONFIG_PAGE_COUNTER=y
CONFIG_MEMCG=y
CONFIG_MEMCG_KMEM=y
CONFIG_SCHED_MM_CID=y
CONFIG_CPUSETS=y
CONFIG_PROC_PID_CPUSET=y
```
